## boards/others/stm32h743iit6_cb_v1_5/Kconfig.stm32h743iit6_cb_v1_5
```kconfig
# Copyright (c) 2026 Caspar Friedrich <c.s.w.friedrich@gmail.com>
# SPDX-License-Identifier: Apache-2.0

config BOARD_STM32H743IIT6_CB_V1_5
	select SOC_STM32H743XX
```

## boards/others/stm32h743iit6_cb_v1_5/board.yml
```yaml
board:
  name: stm32h743iit6_cb_v1_5
  full_name: STM32H743IIT6 CB V1.5
  vendor: Dongguan Huiqin Zhiyuan Technology Co., Ltd.
  socs:
    - name: stm32h743xx
```
