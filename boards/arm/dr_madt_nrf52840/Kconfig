## boards/arm/dr_madt_nrf52840/Kconfig
```kconfig
# Dr. Madt (nRF52840) board configuration

# Copyright (c) Caspar Friedrich <c.s.w.friedrich@gmail.com>
# SPDX-License-Identifier: Apache-2.0

if BOARD_DR_MADT_NRF52840

config BOARD_ENABLE_DCDC
	bool "DCDC mode"
	select SOC_DCDC_NRF52X
	default y

config BOARD_ENABLE_DCDC_HV
	bool "High Voltage DCDC converter"
	select SOC_DCDC_NRF52X_HV
	default y

endif # BOARD_DR_MADT_NRF52840
```

## boards/arm/dr_madt_nrf52840/Kconfig.board
```kconfig
# Dr. Madt (nRF52840) board configuration

# Copyright (c) Caspar Friedrich <c.s.w.friedrich@gmail.com>
# SPDX-License-Identifier: Apache-2.0

config BOARD_DR_MADT_NRF52840
	bool "Dr. Madt (nRF52840)"
	depends on SOC_NRF52840_QIAA
```

## boards/arm/dr_madt_nrf52840/Kconfig.defconfig
```kconfig
# Dr. Madt (nRF52840) board configuration

# Copyright (c) Caspar Friedrich <c.s.w.friedrich@gmail.com>
# SPDX-License-Identifier: Apache-2.0

if BOARD_DR_MADT_NRF52840

config BOARD
	default "dr_madt_nrf52840"

config BT_CTLR
	default BT

endif # BOARD_DR_MADT_NRF52840
```

## boards/fanke/fk743m5-xih6/Kconfig.fk743m5-xih6
```kconfig
# Copyright (c) 2025 Caspar Friedrich <c.s.w.friedrich@gmail.com>
# SPDX-License-Identifier: Apache-2.0

config BOARD_FK743M5_XIH6
	select SOC_STM32H743XX
```

## boards/weact/coreboard_f405rg/Kconfig.coreboard_f405rg
```kconfig
# Copyright (c) 2024 Caspar Friedrich <c.s.w.friedrich@gmail.com>
# SPDX-License-Identifier: Apache-2.0

config BOARD_COREBOARD_F405RG
	select SOC_STM32F405XX
```

## boards/weact/coreboard_f405rg/coreboard_f405rg_defconfig
```kconfig
# SPDX-License-Identifier: Apache-2.0

# Kernel
CONFIG_ARM_MPU=y
CONFIG_HW_STACK_PROTECTION=y

# Drivers
CONFIG_CLOCK_CONTROL=y
CONFIG_CONSOLE=y
CONFIG_GPIO=y
CONFIG_PINCTRL=y
CONFIG_SERIAL=y
CONFIG_UART_CONSOLE=y
```

## boards/weact/coreboard_f412re/Kconfig.coreboard_f412re
```kconfig
# Copyright (c) 2024 Caspar Friedrich <c.s.w.friedrich@gmail.com>
# SPDX-License-Identifier: Apache-2.0

config BOARD_COREBOARD_F412RE
	select SOC_STM32F412RX
```

## boards/weact/coreboard_h503cb/Kconfig.coreboard_h503cb
```kconfig
# Copyright (c) 2024 Caspar Friedrich <c.s.w.friedrich@gmail.com>
# SPDX-License-Identifier: Apache-2.0

config BOARD_COREBOARD_H503CB
	select SOC_STM32H503XX
```

## boards/weact/coreboard_h743vi/Kconfig.coreboard_h743vi
```kconfig
# Copyright (c) 2024 Caspar Friedrich <c.s.w.friedrich@gmail.com>
# SPDX-License-Identifier: Apache-2.0

config BOARD_COREBOARD_H743VI
	select SOC_STM32H743XX
```

## drivers/serial/Kconfig.sc16is7xx
```kconfig
# Copyright (c) 2024, Caspar Friedrich <c.s.w.friedrich@gmail.com>
# SPDX-License-Identifier: Apache-2.0

DT_COMPAT_NXP_SC16IS7XX := nxp,sc16is7xx
DT_COMPAT_NXP_SC16IS7XX_UART := nxp,sc16is7xx-uart
DT_COMPAT_NXP_SC16IS7XX_GPIO := nxp,sc16is7xx-gpio

menuconfig UART_SC16IS7XX
	bool "NXP SC16IS7XX I2C/SPI to UART bridge"
	default $(dt_compat_enabled,$(DT_COMPAT_NXP_SC16IS7XX))
	select GPIO
	select I2C if $(dt_compat_on_bus,$(DT_COMPAT_NXP_SC16IS7XX),i2c)
	select SPI if $(dt_compat_on_bus,$(DT_COMPAT_NXP_SC16IS7XX),spi)
	select SERIAL_HAS_DRIVER
	select SERIAL_SUPPORT_INTERRUPT

if UART_SC16IS7XX

config UART_SC16IS7XX_INIT_PRIORITY
	int "SC16IS7XX driver initialization priority"
	default KERNEL_INIT_PRIORITY_DEVICE

config UART_SC16IS7XX_UART
	bool "Enable UART channels"
	default $(dt_compat_enabled,$(DT_COMPAT_NXP_SC16IS7XX_UART))

config UART_SC16IS7XX_GPIO
	bool "Enable extra GPIOs"
	default $(dt_compat_enabled,$(DT_COMPAT_NXP_SC16IS7XX_GPIO))

endif # UART_SC16IS7XX
```

## dts/bindings/serial/nxp,sc16is7xx-common.yaml
```yaml
description: |
  NXP SC16IS7XX, I2C/SPI to UART interface (common options)

bus: sc16is7xx

properties:
  clock-frequency:
    type: int
    required: true
    description: Clock frequency in Hz

  irq-gpios:
    type: phandle-array
    required: false
    description: tbd

  reset-gpios:
    type: phandle-array
    required: false
    description: tbd

  use-software-reset:
    type: boolean
    required: false
    description: |
      Use software reset instead of a gpio. Only available on SC16IS75x/SC16IS76x.
```

## dts/bindings/serial/nxp,sc16is7xx-gpio.yaml
```yaml
description: |
  NXP SC16IS7XX, I2C/SPI to UART interface (I/O control node)

  Note: This is inverted becaus the upper GPIOs ([7:4]) are assosiated with
        UART-channel A and the lower ones ([3:0]) with channel B.

compatible: "nxp,sc16is7xx-gpio"

include: [base.yaml, gpio-controller.yaml]

on-bus: sc16is7xx

properties:
  ngpios:
    required: true
    const: 8

  "#gpio-cells":
    const: 2

gpio-cells:
  - pin
  - flags
```

## dts/bindings/serial/nxp,sc16is7xx-i2c.yaml
```yaml
description: |
  NXP SC16IS7XX, I2C/SPI to UART interface (i2c parent node)

compatible: "nxp,sc16is7xx"

include: ["i2c-device.yaml", "nxp,sc16is7xx-common.yaml"]
```

## dts/bindings/serial/nxp,sc16is7xx-spi.yaml
```yaml
description: |
  NXP SC16IS7XX, I2C/SPI to UART interface (spi parent node)

compatible: "nxp,sc16is7xx"

include: ["spi-device.yaml", "nxp,sc16is7xx-common.yaml"]
```

## dts/bindings/serial/nxp,sc16is7xx-uart.yaml
```yaml
description: |
  NXP SC16IS7XX, I2C/SPI to UART interface (channel control node)
  There can be two nodes, the first one (@0) controls channel A and the
  second one (@1) channel B.

compatible: "nxp,sc16is7xx-uart"

include: [uart-controller.yaml]

on-bus: sc16is7xx

properties:
  reg:
    required: true
```
